## main/Kconfig.projbuild
```kconfig
menu "Example Configuration"

    config ESP_WIFI_SSID
        string "WiFi SSID"
        default "ESP32 S3"
        help
            SSID (network name) for the example to connect to.

    config ESP_WIFI_PASSWORD
        string "WiFi Password"
        default "123456789"
        help
            WiFi password (WPA or WPA2) for the example to use.
    config ESP_WIFI_CHANNEL
        int "WiFi Channel"
        range 1 13
        default 1
        help
            WiFi channel (network channel) for the example to use.

    config ESP_MAX_STA_CONN
        int "Maximal STA connections"
        default 4
        help
            Max number of the STA connects to AP.

menu "Hardware Configuration"

    config RGB_LED_GPIO
        int "Onboard addressable RGB LED GPIO"
        range 0 48
        default 48
        help
            GPIO connected to the onboard WS2812-compatible RGB LED data input.
            Change this value if your ESP32-S3 board uses a different LED pin.

endmenu
endmenu
```
